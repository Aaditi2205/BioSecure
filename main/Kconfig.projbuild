## main/Kconfig.projbuild
```kconfig
menu "BioSecure"
config BIOSECURE_DEVICE_ID
    string "Device identifier"
    default "BIOSECURE-UNPROVISIONED"
config BIOSECURE_ATTENDANCE_URL
    string "HTTPS attendance endpoint"
    default "https://example.invalid/api/v1/attendance"
config BIOSECURE_WIFI_SSID
    string "Wi-Fi SSID (development only; provision NVS for production)"
    default ""
config BIOSECURE_WIFI_PASSWORD
    string "Wi-Fi password (development only; provision NVS for production)"
    default ""
config BIOSECURE_DUPLICATE_WINDOW_MS
    int "Duplicate suppression window"
    default 45000
config BIOSECURE_MAX_FAILED_ATTEMPTS
    int "Failed attempts before lockout"
    default 5
config BIOSECURE_LOCKOUT_MS
    int "Lockout duration"
    default 60000
endmenu
```

## sdkconfig.defaults
```kconfig
CONFIG_IDF_TARGET="esp32s3"
CONFIG_FREERTOS_HZ=1000
CONFIG_ESP_TASK_WDT_EN=y
CONFIG_MBEDTLS_CERTIFICATE_BUNDLE=y
CONFIG_MBEDTLS_CERTIFICATE_BUNDLE_DEFAULT_FULL=y
CONFIG_COMPILER_CXX_EXCEPTIONS=n
CONFIG_COMPILER_CXX_RTTI=n
CONFIG_PARTITION_TABLE_SINGLE_APP_LARGE=y
```
